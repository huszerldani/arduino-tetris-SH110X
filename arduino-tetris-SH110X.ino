#include "constants.h"
#include "globals.h"

#include <Wire.h>
#include <Adafruit_GFX.h>
#include <Adafruit_SH110X.h>

#define I2C_ADDRESS 0x3c
#define WIDTH 64    // OLED display width, in pixels
#define HEIGHT 128  // OLED display height, in pixels

// Game pieces
static const unsigned char PROGMEM logo[] = {
  0x00, 0x00, 0x00, 0x00, 0x00, 0x00, 0x00, 0x00, 0x00, 0x00, 0x00, 0x00, 0x00, 0x00, 0x00, 0x00, 
	0x00, 0x00, 0x00, 0x00, 0x00, 0x00, 0x00, 0x00, 0x00, 0x00, 0x00, 0x00, 0x00, 0x00, 0x00, 0x00, 
	0x00, 0x00, 0x00, 0x00, 0x00, 0x00, 0x00, 0x00, 0x00, 0x00, 0x00, 0x00, 0x00, 0x00, 0x00, 0x00, 
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	0x00, 0x00, 0x00, 0x00, 0x00, 0x00, 0x00, 0x00, 0x00, 0x00, 0x00, 0x00, 0x00, 0x00, 0x00, 0x00
};

// BATTERY
const float referenceVoltage = 3.3;
const float dividerRatio = 2.0;
const float minVoltage = 3.0; // Voltage at 0% charge
const float maxVoltage = 4.2; // Voltage at 100% charge

// VIBRATION
unsigned long vibrationStartTime = 0;
int vibrationDuration = 100;
bool vibrating = false;

// INVERT DISPLAY
unsigned long invertStartTime = 0;
int invertDuration = 100;
bool invert = false;

enum Scene {
  SCENE_MENU,
  SCENE_GAME,
  SCENE_GAME_OVER
};

Scene currentScreen = SCENE_MENU;

Adafruit_SH1106G display(128, 64, &Wire, -1);

void loopMenu();
void loopGame();
void setupMenu();

//-------------------
// --- SETUP ------
//-------------------
void setup() {
  pinMode(BUTTON_LEFT_PIN, INPUT_PULLUP);
  pinMode(BUTTON_RIGHT_PIN, INPUT_PULLUP);
  pinMode(BUTTON_UP_PIN, INPUT_PULLUP);
  pinMode(BUTTON_DOWN_PIN, INPUT_PULLUP);
  pinMode(VIBRATOR_PIN, OUTPUT);

  display.begin(I2C_ADDRESS, true);
  display.setRotation(3);
  display.clearDisplay();

  randomSeed(analogRead(0));

  nextType = random(TYPES);

  setupMenu();
}

//-------------------
// --- LOOP ------
//-------------------
void loop() {
  updateVibration();
  updateInvert();
  
  checkBattery();

  if (currentScreen == SCENE_MENU) {
    loopMenu();
  }

  if (currentScreen == SCENE_GAME) {
    loopGame();
  }

  if (currentScreen == SCENE_GAME_OVER) {
    loopGameOver();
  }
}

void loopGameOver() {
  if (
    !digitalRead(BUTTON_UP_PIN) ||
    !digitalRead(BUTTON_DOWN_PIN) ||
    !digitalRead(BUTTON_LEFT_PIN) ||
    !digitalRead(BUTTON_RIGHT_PIN)
  ) {
    restartGame();
  }
}

void vibrate(int duration = 100) {
  vibrationDuration = duration;
  vibrationStartTime = millis();
  digitalWrite(VIBRATOR_PIN, HIGH);
  vibrating = true;
}

void invertDisplay(int duration = 100) {
  invertDuration = duration;
  invertStartTime = millis();
  display.invertDisplay(true);
  invert = true;
}

void updateVibration() {
  if (vibrating && (millis() - vibrationStartTime >= vibrationDuration)) {
    digitalWrite(VIBRATOR_PIN, LOW);
    vibrating = false;
  }
}

void updateInvert() {
  if (invert && (millis() - invertStartTime >= invertDuration)) {
    display.invertDisplay(false);
    invert = false;
  }
}

void displayGameOver() {
  display.fillRect(3, 50, 58, 40, SH110X_WHITE);
  display.drawRect(5, 52, 54, 36, SH110X_BLACK);

  display.setTextSize(2);
  display.setTextColor(SH110X_BLACK);
  display.setCursor(9, 55);
  display.print("GAME");
  display.setCursor(9, 70);
  display.print("OVER");

  display.fillRoundRect(11, 100, 40, 14, 2, SH110X_BLACK);
  display.drawRoundRect(11, 100, 40, 14, 2, SH110X_WHITE);
  display.setTextSize(1);
  display.setTextColor(SH110X_WHITE);
  display.setCursor(17, 103);
  display.print("retry");

  display.display();
}

void checkBattery() {
  int sensorValue = analogRead(BATTERY_PIN); // Read the analog input
  float voltage = sensorValue * (referenceVoltage / 4095.0); // Calculate the measured voltage

  if (voltage < 3.3F) {
    display.setTextSize(1);
    display.setTextColor(SH110X_WHITE);
    display.setCursor(30, 2);
    display.println("BAT");
    display.display();
  }
}
